/* Generated by typeslots.py */
{offsetof(PyBufferProcs, bf_getbuffer), offsetof(TyTypeObject, tp_as_buffer)},
{offsetof(PyBufferProcs, bf_releasebuffer), offsetof(TyTypeObject, tp_as_buffer)},
{offsetof(PyMappingMethods, mp_ass_subscript), offsetof(TyTypeObject, tp_as_mapping)},
{offsetof(PyMappingMethods, mp_length), offsetof(TyTypeObject, tp_as_mapping)},
{offsetof(PyMappingMethods, mp_subscript), offsetof(TyTypeObject, tp_as_mapping)},
{offsetof(TyNumberMethods, nb_absolute), offsetof(TyTypeObject, tp_as_number)},
{offsetof(TyNumberMethods, nb_add), offsetof(TyTypeObject, tp_as_number)},
{offsetof(TyNumberMethods, nb_and), offsetof(TyTypeObject, tp_as_number)},
{offsetof(TyNumberMethods, nb_bool), offsetof(TyTypeObject, tp_as_number)},
{offsetof(TyNumberMethods, nb_divmod), offsetof(TyTypeObject, tp_as_number)},
{offsetof(TyNumberMethods, nb_float), offsetof(TyTypeObject, tp_as_number)},
{offsetof(TyNumberMethods, nb_floor_divide), offsetof(TyTypeObject, tp_as_number)},
{offsetof(TyNumberMethods, nb_index), offsetof(TyTypeObject, tp_as_number)},
{offsetof(TyNumberMethods, nb_inplace_add), offsetof(TyTypeObject, tp_as_number)},
{offsetof(TyNumberMethods, nb_inplace_and), offsetof(TyTypeObject, tp_as_number)},
{offsetof(TyNumberMethods, nb_inplace_floor_divide), offsetof(TyTypeObject, tp_as_number)},
{offsetof(TyNumberMethods, nb_inplace_lshift), offsetof(TyTypeObject, tp_as_number)},
{offsetof(TyNumberMethods, nb_inplace_multiply), offsetof(TyTypeObject, tp_as_number)},
{offsetof(TyNumberMethods, nb_inplace_or), offsetof(TyTypeObject, tp_as_number)},
{offsetof(TyNumberMethods, nb_inplace_power), offsetof(TyTypeObject, tp_as_number)},
{offsetof(TyNumberMethods, nb_inplace_remainder), offsetof(TyTypeObject, tp_as_number)},
{offsetof(TyNumberMethods, nb_inplace_rshift), offsetof(TyTypeObject, tp_as_number)},
{offsetof(TyNumberMethods, nb_inplace_subtract), offsetof(TyTypeObject, tp_as_number)},
{offsetof(TyNumberMethods, nb_inplace_true_divide), offsetof(TyTypeObject, tp_as_number)},
{offsetof(TyNumberMethods, nb_inplace_xor), offsetof(TyTypeObject, tp_as_number)},
{offsetof(TyNumberMethods, nb_int), offsetof(TyTypeObject, tp_as_number)},
{offsetof(TyNumberMethods, nb_invert), offsetof(TyTypeObject, tp_as_number)},
{offsetof(TyNumberMethods, nb_lshift), offsetof(TyTypeObject, tp_as_number)},
{offsetof(TyNumberMethods, nb_multiply), offsetof(TyTypeObject, tp_as_number)},
{offsetof(TyNumberMethods, nb_negative), offsetof(TyTypeObject, tp_as_number)},
{offsetof(TyNumberMethods, nb_or), offsetof(TyTypeObject, tp_as_number)},
{offsetof(TyNumberMethods, nb_positive), offsetof(TyTypeObject, tp_as_number)},
{offsetof(TyNumberMethods, nb_power), offsetof(TyTypeObject, tp_as_number)},
{offsetof(TyNumberMethods, nb_remainder), offsetof(TyTypeObject, tp_as_number)},
{offsetof(TyNumberMethods, nb_rshift), offsetof(TyTypeObject, tp_as_number)},
{offsetof(TyNumberMethods, nb_subtract), offsetof(TyTypeObject, tp_as_number)},
{offsetof(TyNumberMethods, nb_true_divide), offsetof(TyTypeObject, tp_as_number)},
{offsetof(TyNumberMethods, nb_xor), offsetof(TyTypeObject, tp_as_number)},
{offsetof(PySequenceMethods, sq_ass_item), offsetof(TyTypeObject, tp_as_sequence)},
{offsetof(PySequenceMethods, sq_concat), offsetof(TyTypeObject, tp_as_sequence)},
{offsetof(PySequenceMethods, sq_contains), offsetof(TyTypeObject, tp_as_sequence)},
{offsetof(PySequenceMethods, sq_inplace_concat), offsetof(TyTypeObject, tp_as_sequence)},
{offsetof(PySequenceMethods, sq_inplace_repeat), offsetof(TyTypeObject, tp_as_sequence)},
{offsetof(PySequenceMethods, sq_item), offsetof(TyTypeObject, tp_as_sequence)},
{offsetof(PySequenceMethods, sq_length), offsetof(TyTypeObject, tp_as_sequence)},
{offsetof(PySequenceMethods, sq_repeat), offsetof(TyTypeObject, tp_as_sequence)},
{-1, offsetof(TyTypeObject, tp_alloc)},
{-1, offsetof(TyTypeObject, tp_base)},
{-1, offsetof(TyTypeObject, tp_bases)},
{-1, offsetof(TyTypeObject, tp_call)},
{-1, offsetof(TyTypeObject, tp_clear)},
{-1, offsetof(TyTypeObject, tp_dealloc)},
{-1, offsetof(TyTypeObject, tp_del)},
{-1, offsetof(TyTypeObject, tp_descr_get)},
{-1, offsetof(TyTypeObject, tp_descr_set)},
{-1, offsetof(TyTypeObject, tp_doc)},
{-1, offsetof(TyTypeObject, tp_getattr)},
{-1, offsetof(TyTypeObject, tp_getattro)},
{-1, offsetof(TyTypeObject, tp_hash)},
{-1, offsetof(TyTypeObject, tp_init)},
{-1, offsetof(TyTypeObject, tp_is_gc)},
{-1, offsetof(TyTypeObject, tp_iter)},
{-1, offsetof(TyTypeObject, tp_iternext)},
{-1, offsetof(TyTypeObject, tp_methods)},
{-1, offsetof(TyTypeObject, tp_new)},
{-1, offsetof(TyTypeObject, tp_repr)},
{-1, offsetof(TyTypeObject, tp_richcompare)},
{-1, offsetof(TyTypeObject, tp_setattr)},
{-1, offsetof(TyTypeObject, tp_setattro)},
{-1, offsetof(TyTypeObject, tp_str)},
{-1, offsetof(TyTypeObject, tp_traverse)},
{-1, offsetof(TyTypeObject, tp_members)},
{-1, offsetof(TyTypeObject, tp_getset)},
{-1, offsetof(TyTypeObject, tp_free)},
{offsetof(TyNumberMethods, nb_matrix_multiply), offsetof(TyTypeObject, tp_as_number)},
{offsetof(TyNumberMethods, nb_inplace_matrix_multiply), offsetof(TyTypeObject, tp_as_number)},
{offsetof(TyAsyncMethods, am_await), offsetof(TyTypeObject, tp_as_async)},
{offsetof(TyAsyncMethods, am_aiter), offsetof(TyTypeObject, tp_as_async)},
{offsetof(TyAsyncMethods, am_anext), offsetof(TyTypeObject, tp_as_async)},
{-1, offsetof(TyTypeObject, tp_finalize)},
{offsetof(TyAsyncMethods, am_send), offsetof(TyTypeObject, tp_as_async)},
{-1, offsetof(TyTypeObject, tp_vectorcall)},
{-1, offsetof(PyHeapTypeObject, ht_token)},
